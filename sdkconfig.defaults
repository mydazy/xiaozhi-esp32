## sdkconfig.defaults
```kconfig
CONFIG_COMPILER_OPTIMIZATION_SIZE=y
CONFIG_COMPILER_CXX_EXCEPTIONS=y
CONFIG_COMPILER_CXX_EXCEPTIONS_EMG_POOL_SIZE=1024
CONFIG_COMPILER_CXX_RTTI=y

CONFIG_BOOTLOADER_COMPILER_OPTIMIZATION_PERF=y
CONFIG_BOOTLOADER_LOG_LEVEL_NONE=y
CONFIG_BOOTLOADER_SKIP_VALIDATE_ALWAYS=y
CONFIG_BOOTLOADER_APP_ROLLBACK_ENABLE=y

CONFIG_HTTPD_MAX_REQ_HDR_LEN=2048
CONFIG_HTTPD_MAX_URI_LEN=2048

CONFIG_PARTITION_TABLE_CUSTOM=y
CONFIG_PARTITION_TABLE_CUSTOM_FILENAME="partitions/v2/16m.csv"
CONFIG_PARTITION_TABLE_OFFSET=0x8000

# P30 长期稳定运行 · 5 类 Watchdog 显式声明（详见 docs/p30-resource-plan.html § 5）
# 历史问题：之前仅声明 timeout，其余依赖 ESP-IDF 默认值，量产前存在被改 default 风险。
CONFIG_ESP_TASK_WDT_EN=y                    # 任务看门狗启用
CONFIG_ESP_TASK_WDT_INIT=y                  # 启动期初始化
# 任务卡死 10s 触发 panic
CONFIG_ESP_TASK_WDT_TIMEOUT_S=10
# 监控 Core 0/1 idle
CONFIG_ESP_TASK_WDT_CHECK_IDLE_TASK_CPU0=y
CONFIG_ESP_TASK_WDT_CHECK_IDLE_TASK_CPU1=y
# 中断看门狗启用
CONFIG_ESP_INT_WDT=y
# 中断卡死 300ms 触发 panic
CONFIG_ESP_INT_WDT_TIMEOUT_MS=300
# 监控 Core 1 中断
CONFIG_ESP_INT_WDT_CHECK_CPU1=y
# 栈越界 canary 检测
CONFIG_FREERTOS_CHECK_STACKOVERFLOW_CANARY=y
# 电压跌落检测 · 阈值 2.6V（最高灵敏）· 中断方式（非立即重启）
CONFIG_ESP_BROWNOUT_DET=y
CONFIG_ESP_BROWNOUT_DET_LVL_SEL_7=y
CONFIG_ESP_BROWNOUT_DET_LVL=7
CONFIG_ESP_BROWNOUT_USE_INTR=y
CONFIG_FREERTOS_GENERATE_RUN_TIME_STATS=y
CONFIG_FREERTOS_USE_STATS_FORMATTING_FUNCTIONS=y
CONFIG_FREERTOS_USE_TRACE_FACILITY=y        # uxTaskGetSystemState 任务运行时统计

CONFIG_ESP_MAIN_TASK_STACK_SIZE=8192
CONFIG_MBEDTLS_DYNAMIC_BUFFER=y
CONFIG_MBEDTLS_SSL_KEEP_PEER_CERTIFICATE=n
CONFIG_ESP_WIFI_IRAM_OPT=n
CONFIG_ESP_WIFI_RX_IRAM_OPT=n
CONFIG_ESP_WIFI_DYNAMIC_RX_MGMT_BUFFER=y

# These entries are copied from ESP-HI (ESP32C3) to reduce memory usage
CONFIG_ESP_WIFI_STATIC_RX_BUFFER_NUM=6
CONFIG_ESP_WIFI_DYNAMIC_RX_BUFFER_NUM=8
CONFIG_NEWLIB_NANO_FORMAT=y
CONFIG_ESP_WIFI_ENTERPRISE_SUPPORT=n

# P30 P0a · INT RAM 优化（2026-04-29 · 详见 docs/p30-resource-plan.html）
# 释放 INT RAM ~21-30 KB，腾给应用层任务栈 + 堆动态高峰
#
# R1 · NimBLE 控制结构挪 PSRAM（INTERNAL → EXTERNAL）· 释放 ~15-20 KB INT
# 副作用：BluFi 配网期 NimBLE 调用慢 ~50ms（PSRAM vs INT 带宽差）
# 配网仅一次性场景，影响可接受。日常运行 NimBLE 不活跃，零影响。
CONFIG_BT_NIMBLE_MEM_ALLOC_MODE_INTERNAL=n
CONFIG_BT_NIMBLE_MEM_ALLOC_MODE_EXTERNAL=y

# R3 · LWIP TCP window 8192 → 4096 · 释放 ~10 KB INT（2026-05-15 激进策略回滚）
# 深度测算（详见对话记录）：Opus 双工 60ms 帧 上行16k/下行24k 合计 ≤ 60 kbps
# BDP（RTT 500ms × 60 kbps）= 3.75 KB · 4096 byte 窗口对极弱网仍有 1.1x 余量
# 业务层队列 2.4s/3.6s 缓冲已远超 SDK 层 TCP 窗口
# 副作用：单 TCP 连接吞吐略降（HTTP Binary 模式已翻倍，对冲）
CONFIG_LWIP_TCP_WND_DEFAULT=4096
# R3' · LWIP TCP 发送 buffer 同步缩 5760 → 4096 · 释放 ~2 KB INT
CONFIG_LWIP_TCP_SND_BUF_DEFAULT=4096

# R4 · WiFi TX buffer 改 DYNAMIC + 16 个（2026-05-15 修复 Kconfig choice 写法）
# 历史：先前写法 STATIC=n + DYNAMIC=y 错误（choice 不能用 =n），被 reconfigure 自动回退到 STATIC=16
# 正确写法：choice 组只设一个 =y，互斥项 IDF 自动推导；TX_BUFFER_TYPE 是派生值，禁止手设
# 节省：~17 KB INT（avoid static 16 preallocation）+ ~27 KB PSRAM（CACHE 自动失效）
CONFIG_ESP_WIFI_DYNAMIC_TX_BUFFER=y
CONFIG_ESP_WIFI_DYNAMIC_TX_BUFFER_NUM=16

# R5 · 噪声抑制 WebRTC → NSNET2（2026-05-15 激进策略）· 释放 ~8-10 KB INT
# NS 神经降噪：2026-05-20 关闭（用户决定，从 sdkconfig 层去掉 NSNET2 模型）
# 选 WEBRTC（choice 无 NONE 选项）→ 模型分区不含 nsnet → afe_audio_processor.cc 中
# esp_srmodel_filter(NSNET) 返回 null → ns_init=false → AFE 管线 NS 整段关闭。
# 因 ns_init=false，WebRTC NS（DSP 算法，否则占 INT RAM）不会被启用，不会反占内部。
# 收益：省 flash（去掉 nsnet2 模型）+ 省 NSNET2 的 PSRAM；内部 RAM 收益很小（NSNET2 本就在 PSRAM）。
# 代价：弱噪声环境麦克风端去噪变弱，AEC/AGC/VAD 仍在。如听感不达标可回滚 NSNET2。
# CONFIG_SR_NSN_NSNET2 is not set
CONFIG_SR_NSN_WEBRTC=y

# ============================================================
# P30 P0a-WiFi · WiFi 模式 SRAM 紧急救援（2026-05-15）
# 实测：WiFi 模式 SRAM free 19.9 KB（4G 53.6 KB · 差 ~35 KB 是 WiFi 协议栈占用）
# 红线 60 KB · 这一轮裁剪目标释放 ~20-25 KB INT
# 项目事实核对：
#   ✅ IPv6 项目内 0 处使用（无 AF_INET6/sockaddr_in6/IPV6 引用）
#   ✅ NETIF_LOOPBACK 项目无 localhost/127.0.0.1 用法
#   ✅ SoftAP（APSTA + 192.168.4.1 网页配网）必须保留 · 但 SoftAP 不需 WPA3
#   ✅ DHCPS 必须保留（SoftAP 配网期手机分配 IP）· STA 数缩到 2
#   ✅ Opus 60ms 帧 < MTU 1440，不需要大 IP 分片重组池
# ============================================================

# R6 · IPv6 全关 · 释放 ~8-10 KB INT
# 项目 0 处使用 IPv6 · 关闭后 ND6/MLDV6 自动失效
CONFIG_LWIP_IPV6=n
# CONFIG_LWIP_IPV6 is not set
# CONFIG_LWIP_ND6 is not set
# CONFIG_LWIP_ESP_MLDV6_REPORT is not set

# NETIF Loopback 开启：esp_http_server 控制 socket(cs_create_ctrl_sock)依赖回环
# AP 配网模式 web 服务器(WifiAp::httpd_start)必需；代价约 +2KB 内部 RAM
CONFIG_LWIP_NETIF_LOOPBACK=y

# R8 · TCP 控制块数量适度裁剪（2026-05-15 回退过激 · 6/4 引发 MQTT 频繁 goodbye）
# 实测教训：6/4 临界，MQTT(1) + WS音频(1) + OTA + HTTP 短连接同时存在时连接被踢
# 折中：active 10 / listening 8（仍比原 16/16 节省 ~2-3 KB INT）
CONFIG_LWIP_MAX_ACTIVE_TCP=10
CONFIG_LWIP_MAX_LISTENING_TCP=8

# R9 · LWIP TCPIP 接收 mbox 回退默认（2026-05-15 回退）
# 实测教训：8 太小，音频 16 帧/秒 + MQTT keepalive 突发溢出 → 丢包 → 服务端 goodbye
# 保留默认 16 不动（每 mbox 仅 ~128 byte，省 1KB 不值得稳定性代价）
CONFIG_LWIP_TCPIP_RECVMBOX_SIZE=16

# R10 · WiFi 管理帧 SBUF 减半 · 释放 ~2-3 KB INT
# 管理帧（beacon/probe/auth）少，32 → 16 充裕
CONFIG_ESP_WIFI_MGMT_SBUF_NUM=16

# R11 · DHCPS STA 数 8 → 2 · 释放 ~1-2 KB INT
# SoftAP 配网仅允许 1-2 个手机连接
CONFIG_LWIP_DHCPS_MAX_STATION_NUM=2

# R12 · SoftAP 关闭 WPA3-SAE · 释放 ~1-2 KB INT
# 配网 SoftAP 用 WPA2 或 open 即可（手机浏览器访问 192.168.4.1）
CONFIG_ESP_WIFI_SOFTAP_SAE_SUPPORT=n
# CONFIG_ESP_WIFI_SOFTAP_SAE_SUPPORT is not set

# R13 · IP 分片重组池 10 → 3 · 释放 ~1 KB INT
# Opus 60ms 帧 < 300 byte < MTU 1440 · 几乎不会分片
CONFIG_LWIP_IP_REASS_MAX_PBUFS=3

# R14 · mDNS DNS 查询支持关 · 释放 ~1 KB INT/Flash
# 项目无 *.local 域名解析需求
CONFIG_LWIP_DNS_SUPPORT_MDNS_QUERIES=n
# CONFIG_LWIP_DNS_SUPPORT_MDNS_QUERIES is not set

# LWIP loopback pbuf 池：回环已启用(httpd 控制 socket)，恢复默认 8
CONFIG_LWIP_LOOPBACK_MAX_PBUFS=8

# R16 · WPA3 高级特性裁剪 · 释放 ~2-3 KB INT
# 保留 WPA3_SAE 基础（路由器兼容） + SAE_H2E（hash-to-element 改进握手）
# 关 SAE_PK（公钥认证 · 家用零需求）+ OWE_STA（机会性加密 · 公共 WiFi 才用）
CONFIG_ESP_WIFI_ENABLE_SAE_PK=n
# CONFIG_ESP_WIFI_ENABLE_SAE_PK is not set
CONFIG_ESP_WIFI_ENABLE_WPA3_OWE_STA=n
# CONFIG_ESP_WIFI_ENABLE_WPA3_OWE_STA is not set

# R17 · 静态 TX buffer 数 16 → 8 · 释放 ~12.8 KB INT（2026-05-19）
# 背景：R4 误判——SPIRAM_TRY_ALLOCATE_WIFI_LWIP=y 时 IDF Kconfig 强制 STATIC TX
#       (esp_wifi/Kconfig: DYNAMIC depends on !TRY_ALLOCATE_WIFI_LWIP)，
#       DYNAMIC 永不生效，25.6 KB 静态 TX 必在内部 RAM。真正杠杆是数量不是类型。
# 依据：连接地址固定单一（CONFIG_OTA_URL），仅 1 条常驻 WS + 偶发 OTA 下载，
#       Opus 双工 ≤60 kbps，16 个（IDF 通用默认，为高吞吐 UDP 设计）严重过配。
# 兜底：CACHE_TX_BUFFER_NUM=32（PSRAM）在静态池耗尽时吸收溢出 TX 帧——
#       此即该 cache 池的设计用途，降静态池属其设计内行为，非激进。
# 验证（物理动作）：真机 OTA 固件下载 + 弱网音频上行回归，确认无 TX 饥饿丢帧。
CONFIG_ESP_WIFI_STATIC_TX_BUFFER_NUM=8

# P30 P0a-2 · NimBLE role 裁剪（2026-04-29）· 释放 ~5-8 KB INT + Flash
# BluFi 配网只需要 PERIPHERAL + BROADCASTER + GATT_SERVER（设备作为外设被手机连接）
# 关掉：CENTRAL（设备主动连别人）/ OBSERVER（被动扫描）/ GATT_CLIENT（读别人的 GATT）
# 副作用：项目内不再支持任何"主动连接其他蓝牙设备"场景（如手柄/耳机配对 · P30 不需要）
CONFIG_BT_NIMBLE_ROLE_CENTRAL=n
CONFIG_BT_NIMBLE_ROLE_OBSERVER=n
CONFIG_BT_NIMBLE_GATT_CLIENT=n

# P30 P0a-3 · BT 控制器轻量化（2026-05-15）· 释放 ~6-10 KB INT
# 已通过 menuconfig 设：MAX_ACT 6→2（每 act 828 byte，省 ~3.3 KB · 见 sdkconfig）
CONFIG_BT_CTRL_DTM_ENABLE=n

# P30 P0a-3 · NimBLE ACL buffer 缩容（2026-05-15）· 释放 ~4 KB INT
# 默认 24 个 × 255 byte ≈ 6 KB INT（HCI 传输层 ACL 收包池）
# BluFi 协议短包居多（SSID/PWD < 100 byte），8 个足够吸收突发
CONFIG_BT_NIMBLE_TRANSPORT_ACL_FROM_LL_COUNT=8

# P30 · NimBLE 示例 GATT 服务全部关闭（2026-05-20）
# BluFi 用自有 profile + GAP，下列 12 个均为 NimBLE 自带 demo 服务，项目从不注册
# 关掉减少编译体积与 GATT 注册表占用；iBeacon 未用、BLE 仅配网，配网后控制器整体释放
CONFIG_BT_NIMBLE_PROX_SERVICE=n
CONFIG_BT_NIMBLE_ANS_SERVICE=n
CONFIG_BT_NIMBLE_CTS_SERVICE=n
CONFIG_BT_NIMBLE_HTP_SERVICE=n
CONFIG_BT_NIMBLE_IPSS_SERVICE=n
CONFIG_BT_NIMBLE_TPS_SERVICE=n
CONFIG_BT_NIMBLE_IAS_SERVICE=n
CONFIG_BT_NIMBLE_LLS_SERVICE=n
CONFIG_BT_NIMBLE_SPS_SERVICE=n
CONFIG_BT_NIMBLE_HR_SERVICE=n
CONFIG_BT_NIMBLE_BAS_SERVICE=n
CONFIG_BT_NIMBLE_DIS_SERVICE=n

# P30 · 关闭 BLE 5.x 扩展特性（2026-05-20）
# BluFi 配网走 legacy 1M PHY 足够；2M/CODED PHY、扩展扫描、周期同步均未用
# 关掉省 LL 层状态/缓冲（内部 RAM）并减小控制器代码
CONFIG_BT_NIMBLE_50_FEATURE_SUPPORT=n
CONFIG_BT_NIMBLE_LL_CFG_FEAT_LE_2M_PHY=n
CONFIG_BT_NIMBLE_LL_CFG_FEAT_LE_CODED_PHY=n
CONFIG_BT_NIMBLE_EXT_SCAN=n
CONFIG_BT_NIMBLE_ENABLE_PERIODIC_SYNC=n

CONFIG_CODEC_I2C_BACKWARD_COMPATIBLE=n

# Fix ML307 FIFO Overflow
CONFIG_UART_ISR_IN_IRAM=y

# Fix ESP_SSL error
CONFIG_MBEDTLS_SSL_RENEGOTIATION=n

# LVGL 9.2.2

CONFIG_LV_OS_NONE=y
CONFIG_LV_USE_CLIB_MALLOC=y
CONFIG_LV_USE_CLIB_STRING=y
CONFIG_LV_USE_CLIB_SPRINTF=y
CONFIG_LV_USE_IMGFONT=y
CONFIG_LV_USE_ASSERT_STYLE=y

# Use compressed font · 56_4 教育卡主秀字体走 RLE 压缩（2.2MB · 防 assets 8MB 分区溢出）
CONFIG_LV_FONT_FMT_TXT_LARGE=y
CONFIG_LV_USE_FONT_COMPRESSED=y
CONFIG_LV_USE_FONT_PLACEHOLDER=n
CONFIG_LV_USE_LODEPNG=y

# Disable extra widgets to save flash size
CONFIG_LV_USE_ANIMIMG=n
CONFIG_LV_USE_CALENDAR=n
CONFIG_LV_USE_CALENDAR_HEADER_ARROW=n
CONFIG_LV_USE_CALENDAR_HEADER_DROPDOWN=n
CONFIG_LV_USE_CHART=n
CONFIG_LV_USE_KEYBOARD=n
CONFIG_LV_USE_LED=n
CONFIG_LV_USE_LIST=n
CONFIG_LV_USE_MENU=n
CONFIG_LV_USE_MSGBOX=n
CONFIG_LV_USE_SPAN=n
CONFIG_LV_USE_SPINBOX=n
CONFIG_LV_USE_SPINNER=n
CONFIG_LV_USE_TABVIEW=n
CONFIG_LV_USE_TILEVIEW=n
CONFIG_LV_USE_WIN=n

CONFIG_LV_BUILD_EXAMPLES=n
CONFIG_LV_BUILD_DEMOS=n

# P30: Log and monitor
CONFIG_LOG_DEFAULT_LEVEL_INFO=y
CONFIG_LOG_MAXIMUM_LEVEL_DEBUG=y
CONFIG_ESP_CONSOLE_UART_BAUDRATE=2000000

# P30: GIF support
CONFIG_LV_USE_GIF=y

# P30: SC7A20H accelerometer wake
CONFIG_EN_SC7A20H_WAKE=y
```
